/*
 * Copyright (c) 2020 The ZMK Contributors
 *
 * SPDX-License-Identifier: MIT
 */

#include "kretstrad.dtsi"

&kscan0 {
    col-gpios
    
    /*
     *   = <&xiao_d 0 GPIO_ACTIVE_HIGH>
    *    , <&xiao_d 1 GPIO_ACTIVE_HIGH>
     *   , <&xiao_d 2 GPIO_ACTIVE_HIGH>
      *  , <&xiao_d 3 GPIO_ACTIVE_HIGH>
     *   , <&xiao_d 6 GPIO_ACTIVE_HIGH>
     *   ;
 */
 
     
            = <&gpio0 2 GPIO_ACTIVE_HIGH>
            , <&gpio0 3 GPIO_ACTIVE_HIGH>
            , <&gpio1 15 GPIO_ACTIVE_HIGH>
            , <&gpio0 28 GPIO_ACTIVE_HIGH>
            , <&gpio0 10 GPIO_ACTIVE_HIGH>
            , <&gpio0 5 GPIO_ACTIVE_HIGH>
            ;
};
